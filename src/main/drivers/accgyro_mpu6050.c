/*
 * This file is part of Cleanflight.
 *
 * Cleanflight is free software: you can redistribute it and/or modify
 * it under the terms of the GNU General Public License as published by
 * the Free Software Foundation, either version 3 of the License, or
 * (at your option) any later version.
 *
 * Cleanflight is distributed in the hope that it will be useful,
 * but WITHOUT ANY WARRANTY; without even the implied warranty of
 * MERCHANTABILITY or FITNESS FOR A PARTICULAR PURPOSE.  See the
 * GNU General Public License for more details.
 *
 * You should have received a copy of the GNU General Public License
 * along with Cleanflight.  If not, see <http://www.gnu.org/licenses/>.
 */

#include <stdbool.h>
#include <stdint.h>
#include <stdlib.h>

#include "platform.h"
#include "build_config.h"
#include "debug.h"

#include "common/maths.h"

#include "nvic.h"

#include "system.h"
#include "gpio.h"
#include "exti.h"
#include "bus_i2c.h"

#include "sensor.h"
#include "accgyro.h"
#include "accgyro_mpu.h"
#include "accgyro_mpu6050.h"
#include "string.h"
extern uint8_t mpuLowPassFilter;

//#define DEBUG_MPU_DATA_READY_INTERRUPT

// MPU6050, Standard address 0x68
// MPU_INT on PB13 on rev4 Naze32 hardware
#define MPU6050_ADDRESS         0x68

#define DMP_MEM_START_ADDR 0x6E
#define DMP_MEM_R_W 0x6F

#define MPU6050_SMPLRT_DIV      0       // 8000Hz

static void mpu6050AccInit(void);
static void mpu6050GyroInit(uint16_t lpf);
static uint8_t dmpInitialize(void);

bool mpu6050AccDetect(acc_t *acc) {
    if (mpuDetectionResult.sensor != MPU_60x0) {
        return false;
    }

    acc->init = mpu6050AccInit;
    acc->read = mpuAccRead;
    acc->revisionCode = (mpuDetectionResult.resolution == MPU_HALF_RESOLUTION ? 'o' : 'n'); // es/non-es variance between MPU6050 sensors, half of the naze boards are mpu6000ES.

    return true;
}

bool mpu6050GyroDetect(gyro_t *gyro) {
    if (mpuDetectionResult.sensor != MPU_60x0) {
        return false;
    }
    gyro->init = mpu6050GyroInit;
    gyro->read = mpuGyroRead;

    // 16.4 dps/lsb scalefactor
    gyro->scale = 1.0f / 16.4f;

    return true;
}

static void mpu6050AccInit(void) {
    mpuIntExtiInit();

    switch (mpuDetectionResult.resolution) {
        case MPU_HALF_RESOLUTION:
            acc_1G = 256 * 8;
            break;
        case MPU_FULL_RESOLUTION:
            acc_1G = 512 * 8;
            break;
    }
}

static void mpu6050GyroInit(uint16_t lpf) {
    bool ack;

    mpuIntExtiInit();

    uint8_t mpuLowPassFilter = determineMPULPF(lpf);

    ack = mpuConfiguration.write(MPU_RA_PWR_MGMT_1, 0x80); //PWR_MGMT_1    -- DEVICE_RESET 1
    delay(100);
    ack = mpuConfiguration.write(MPU_RA_SMPLRT_DIV, 0x00); //SMPLRT_DIV    -- SMPLRT_DIV = 0  Sample Rate = Gyroscope Output Rate / (1 + SMPLRT_DIV)
    ack = mpuConfiguration.write(MPU_RA_PWR_MGMT_1, 0x03); //PWR_MGMT_1    -- SLEEP 0; CYCLE 0; TEMP_DIS 0; CLKSEL 3 (PLL with Z Gyro reference)
    delay(15); //PLL Settling time when changing CLKSEL is max 10ms.  Use 15ms to be sure 
    ack = mpuConfiguration.write(MPU_RA_CONFIG, mpuLowPassFilter); //CONFIG        -- EXT_SYNC_SET 0 (disable input pin for data sync) ; default DLPF_CFG = 0 => ACC bandwidth = 260Hz  GYRO bandwidth = 256Hz)
    ack = mpuConfiguration.write(MPU_RA_GYRO_CONFIG, INV_FSR_2000DPS << 3); //GYRO_CONFIG   -- FS_SEL = 3: Full scale set to 2000 deg/sec

    // ACC Init stuff.
    // Accel scale 8g (4096 LSB/g)
    ack = mpuConfiguration.write(MPU_RA_ACCEL_CONFIG, INV_FSR_8G << 3);

    ack = mpuConfiguration.write(MPU_RA_INT_PIN_CFG,
            0 << 7 | 0 << 6 | 0 << 5 | 0 << 4 | 0 << 3 | 0 << 2 | 1 << 1 | 0 << 0); // INT_PIN_CFG   -- INT_LEVEL_HIGH, INT_OPEN_DIS, LATCH_INT_DIS, INT_RD_CLEAR_DIS, FSYNC_INT_LEVEL_HIGH, FSYNC_INT_DIS, I2C_BYPASS_EN, CLOCK_DIS

#ifdef USE_MPU_DATA_READY_SIGNAL
    ack = mpuConfiguration.write(MPU_RA_INT_ENABLE, MPU_RF_DATA_RDY_EN);
#endif


    dmpInitialize();

    UNUSED(ack);
}




#define MPU6050_TC_OFFSET_BIT       6
#define MPU6050_TC_OFFSET_LENGTH    6

#define MPU6050_TC_OTP_BNK_VLD_BIT 0


#define MPU6050_CFG_EXT_SYNC_SET_BIT    5
#define MPU6050_CFG_EXT_SYNC_SET_LENGTH 3

#define MPU6050_EXT_SYNC_TEMP_OUT_L     0x1

#define MPU6050_USERCTRL_DMP_EN_BIT             7
#define MPU6050_USERCTRL_FIFO_EN_BIT            6
#define MPU6050_USERCTRL_I2C_MST_EN_BIT         5
#define MPU6050_USERCTRL_I2C_IF_DIS_BIT         4
#define MPU6050_USERCTRL_DMP_RESET_BIT          3
#define MPU6050_USERCTRL_FIFO_RESET_BIT         2
#define MPU6050_USERCTRL_I2C_MST_RESET_BIT      1
#define MPU6050_USERCTRL_SIG_COND_RESET_BIT     0


#define MPU6050_DMP_MEMORY_BANKS        8
#define MPU6050_DMP_MEMORY_BANK_SIZE    256
#define MPU6050_DMP_MEMORY_CHUNK_SIZE   16


#define MPU6050_DMP_CODE_SIZE       1929    // dmpMemory[]
#define MPU6050_DMP_CONFIG_SIZE     192     // dmpConfig[]
#define MPU6050_DMP_UPDATES_SIZE    47      // dmpUpdates[]

/* ================================================================================================ *
 | Default MotionApps v2.0 42-byte FIFO packet structure:                                           |
 |                                                                                                  |
 | [QUAT W][      ][QUAT X][      ][QUAT Y][      ][QUAT Z][      ][GYRO X][      ][GYRO Y][      ] |
 |   0   1   2   3   4   5   6   7   8   9  10  11  12  13  14  15  16  17  18  19  20  21  22  23  |
 |                                                                                                  |
 | [GYRO Z][      ][ACC X ][      ][ACC Y ][      ][ACC Z ][      ][      ]                         |
 |  24  25  26  27  28  29  30  31  32  33  34  35  36  37  38  39  40  41                          |
 * ================================================================================================ */

// this block of memory gets written to the MPU on start-up, and it seems
// to be volatile memory, so it has to be done each time (it only takes ~1
// second though)
const unsigned char dmpMemory[MPU6050_DMP_CODE_SIZE] = {
    // bank 0, 256 bytes
    0xFB, 0x00, 0x00, 0x3E, 0x00, 0x0B, 0x00, 0x36, 0x00, 0x01, 0x00, 0x02, 0x00, 0x03, 0x00, 0x00,
    0x00, 0x65, 0x00, 0x54, 0xFF, 0xEF, 0x00, 0x00, 0xFA, 0x80, 0x00, 0x0B, 0x12, 0x82, 0x00, 0x01,
    0x00, 0x02, 0x00, 0x00, 0x00, 0x00, 0x00, 0x00, 0x00, 0x00, 0x00, 0x00, 0x00, 0x00, 0x00, 0x00,
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    0xFF, 0xE6, 0x80, 0x79, 0x02, 0x00, 0x00, 0x00, 0x00, 0x00, 0xD0, 0xD6, 0x00, 0x00, 0x27, 0x10,

    // bank 1, 256 bytes
    0xFB, 0x00, 0x00, 0x00, 0x40, 0x00, 0x00, 0x00, 0x00, 0x00, 0x00, 0x00, 0x00, 0x00, 0x00, 0x00,
    0x00, 0x00, 0x00, 0x01, 0x00, 0x00, 0x00, 0x00, 0x00, 0x00, 0x01, 0x00, 0x01, 0x00, 0x00, 0x00,
    0x00, 0x00, 0xFA, 0x36, 0xFF, 0xBC, 0x30, 0x8E, 0x00, 0x05, 0xFB, 0xF0, 0xFF, 0xD9, 0x5B, 0xC8,
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    0x00, 0x00, 0x25, 0x4D, 0x00, 0x2F, 0x70, 0x6D, 0x00, 0x00, 0x05, 0xAE, 0x00, 0x0C, 0x02, 0xD0,

    // bank 2, 256 bytes
    0x00, 0x00, 0x00, 0x00, 0x00, 0x65, 0x00, 0x54, 0xFF, 0xEF, 0x00, 0x00, 0x00, 0x00, 0x00, 0x00,
    0x00, 0x00, 0x01, 0x00, 0x00, 0x44, 0x00, 0x00, 0x00, 0x00, 0x0C, 0x00, 0x00, 0x00, 0x01, 0x00,
    0x00, 0x00, 0x00, 0x00, 0x00, 0x65, 0x00, 0x00, 0x00, 0x54, 0x00, 0x00, 0xFF, 0xEF, 0x00, 0x00,
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    0x00, 0x00, 0x00, 0x00, 0x00, 0x00, 0x00, 0x00, 0x00, 0x00, 0x00, 0x00, 0x00, 0x00, 0x00, 0x00,

    // bank 3, 256 bytes
    0xD8, 0xDC, 0xBA, 0xA2, 0xF1, 0xDE, 0xB2, 0xB8, 0xB4, 0xA8, 0x81, 0x91, 0xF7, 0x4A, 0x90, 0x7F,
    0x91, 0x6A, 0xF3, 0xF9, 0xDB, 0xA8, 0xF9, 0xB0, 0xBA, 0xA0, 0x80, 0xF2, 0xCE, 0x81, 0xF3, 0xC2,
    0xF1, 0xC1, 0xF2, 0xC3, 0xF3, 0xCC, 0xA2, 0xB2, 0x80, 0xF1, 0xC6, 0xD8, 0x80, 0xBA, 0xA7, 0xDF,
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    0xB8, 0xA2, 0xDF, 0xDF, 0xDF, 0xA3, 0xDF, 0xDF, 0xDF, 0xD8, 0xD8, 0xF1, 0xB8, 0xA8, 0xB2, 0x86,

    // bank 4, 256 bytes
    0xB4, 0x98, 0x0D, 0x35, 0x5D, 0xB8, 0xAA, 0x98, 0xB0, 0x87, 0x2D, 0x35, 0x3D, 0xB2, 0xB6, 0xBA,
    0xAF, 0x8C, 0x96, 0x19, 0x8F, 0x9F, 0xA7, 0x0E, 0x16, 0x1E, 0xB4, 0x9A, 0xB8, 0xAA, 0x87, 0x2C,
    0x54, 0x7C, 0xB9, 0xA3, 0xDE, 0xDF, 0xDF, 0xA3, 0xB1, 0x80, 0xF2, 0xC4, 0xCD, 0xC9, 0xF1, 0xB8,
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    0xC8, 0x9F, 0x12, 0x9E, 0xF3, 0x15, 0xA8, 0xDA, 0x12, 0x10, 0xD8, 0xF1, 0xAF, 0xC8, 0x97, 0x87,

    // bank 5, 256 bytes
    0x34, 0xB5, 0xB9, 0x94, 0xA4, 0x21, 0xF3, 0xD9, 0x22, 0xD8, 0xF2, 0x2D, 0xF3, 0xD9, 0x2A, 0xD8,
    0xF2, 0x35, 0xF3, 0xD9, 0x32, 0xD8, 0x81, 0xA4, 0x60, 0x60, 0x61, 0xD9, 0x61, 0xD8, 0x6C, 0x68,
    0x69, 0xD9, 0x69, 0xD8, 0x74, 0x70, 0x71, 0xD9, 0x71, 0xD8, 0xB1, 0xA3, 0x84, 0x19, 0x3D, 0x5D,
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    0x8A, 0x64, 0x48, 0x31, 0x8B, 0x30, 0x49, 0x60, 0xA5, 0x88, 0x20, 0x09, 0x71, 0x58, 0x44, 0x68,

    // bank 6, 256 bytes
    0x11, 0x39, 0x64, 0x49, 0x30, 0x19, 0xF1, 0xAC, 0x00, 0x2C, 0x54, 0x7C, 0xF0, 0x8C, 0xA8, 0x04,
    0x28, 0x50, 0x78, 0xF1, 0x88, 0x97, 0x26, 0xA8, 0x59, 0x98, 0xAC, 0x8C, 0x02, 0x26, 0x46, 0x66,
    0xF0, 0x89, 0x9C, 0xA8, 0x29, 0x51, 0x79, 0x24, 0x70, 0x59, 0x44, 0x69, 0x38, 0x64, 0x48, 0x31,
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    0xAC, 0x91, 0x2C, 0x4C, 0x6C, 0x8A, 0x9B, 0x2D, 0xD9, 0xD8, 0xD8, 0x51, 0xD9, 0xD8, 0xD8, 0x79,

    // bank 7, 138 bytes (remainder)
    0xD9, 0xD8, 0xD8, 0xF1, 0x9E, 0x88, 0xA3, 0x31, 0xDA, 0xD8, 0xD8, 0x91, 0x2D, 0xD9, 0x28, 0xD8,
    0x4D, 0xD9, 0x48, 0xD8, 0x6D, 0xD9, 0x68, 0xD8, 0xB1, 0x83, 0x93, 0x35, 0x3D, 0x80, 0x25, 0xDA,
    0xD8, 0xD8, 0x85, 0x69, 0xDA, 0xD8, 0xD8, 0xB4, 0x93, 0x81, 0xA3, 0x28, 0x34, 0x3C, 0xF3, 0xAB,
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    0xB9, 0xA7, 0xF1, 0x26, 0x26, 0x26, 0xD8, 0xD8, 0xFF
};

// thanks to Noah Zerkin for piecing this stuff together!
const unsigned char dmpConfig[MPU6050_DMP_CONFIG_SIZE] = {
    //  BANK    OFFSET  LENGTH  [DATA]
    0x03, 0x7B, 0x03, 0x4C, 0xCD, 0x6C, // FCFG_1 inv_set_gyro_calibration
    0x03, 0xAB, 0x03, 0x36, 0x56, 0x76, // FCFG_3 inv_set_gyro_calibration
    0x00, 0x68, 0x04, 0x02, 0xCB, 0x47, 0xA2, // D_0_104 inv_set_gyro_calibration
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    0x00, 0xA3, 0x01, 0x00, // D_0_163 inv_set_dead_zone
    // SPECIAL 0x01 = enable interrupts
    0x00, 0x00, 0x00, 0x01, // SET INT_ENABLE at i=22, SPECIAL INSTRUCTION
    0x07, 0x86, 0x01, 0xFE, // CFG_6 inv_set_fifo_interupt
    0x07, 0x41, 0x05, 0xF1, 0x20, 0x28, 0x30, 0x38, // CFG_8 inv_send_quaternion
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    0x02, 0x16, 0x02, 0x00, 0x01 // D_0_22 inv_set_fifo_rate

    // This very last 0x01 WAS a 0x09, which drops the FIFO rate down to 20 Hz. 0x07 is 25 Hz,
    // 0x01 is 100Hz. Going faster than 100Hz (0x00=200Hz) tends to result in very noisy data.
    // DMP output frequency is calculated easily using this equation: (200Hz / (1 + value))

    // It is important to make sure the host processor can keep up with reading and processing
    // the FIFO output at the desired rate. Handling FIFO overflow cleanly is also a good idea.
};

const unsigned char dmpUpdates[MPU6050_DMP_UPDATES_SIZE] = {
    0x01, 0xB2, 0x02, 0xFF, 0xFF,
    0x01, 0x90, 0x04, 0x09, 0x23, 0xA1, 0x35,
    0x01, 0x6A, 0x02, 0x06, 0x00,
    0x01, 0x60, 0x08, 0x00, 0x00, 0x00, 0x00, 0x00, 0x00, 0x00, 0x00,
    0x00, 0x60, 0x04, 0x40, 0x00, 0x00, 0x00,
    0x01, 0x62, 0x02, 0x00, 0x00,
    0x00, 0x60, 0x04, 0x00, 0x40, 0x00, 0x00
};

void SetBits(uint8_t reg, uint8_t bits) {
    uint8_t data;
    mpuConfiguration.read(reg, 1, &data);
    data |= bits;
    mpuConfiguration.write(reg, data);
}

void ClearBits(uint8_t reg, uint8_t bits) {
    uint8_t data;
    mpuConfiguration.read(reg, 1, &data);
    data &= ~bits;
    mpuConfiguration.write(reg, data);
}

uint8_t ReadBits(uint8_t reg,uint8_t offset,uint8_t lenght)
{
    uint8_t data;
    mpuConfiguration.read(reg, 1, &data);
    data >>= (offset + 1 -lenght);
    data &= (0xff>>(8-lenght));
    return (data);
}

void WriteBits(uint8_t reg,uint8_t offset,uint8_t lenght,uint8_t data)
{
    uint8_t tmp;
    mpuConfiguration.read(reg, 1, &tmp);
    data &= (0xff>>(8-lenght));
    data <<=offset;
    tmp ^=data;
    mpuConfiguration.write(reg,tmp);
}

uint16_t getFIFOCount(void) {
    uint8_t buffer[2];
    
  //  SetBits(MPU_RA_USER_CTRL, 1<<MPU6050_USERCTRL_FIFO_RESET_BIT);
    
    mpuConfiguration.read(MPU_RA_FIFO_COUNTH, 2, buffer);
    return (((uint16_t)buffer[0]) << 8) | buffer[1];
}

void getFIFOBytes(uint8_t *data, uint8_t length) {
    mpuConfiguration.read(MPU_RA_FIFO_R_W, length, data);
}

void setDMPEnabled(bool enabled) {
    WriteBits(MPU_RA_USER_CTRL,MPU6050_USERCTRL_DMP_EN_BIT,1,enabled);
}

void resetDMP(void) {
     WriteBits(MPU_RA_USER_CTRL,MPU6050_USERCTRL_DMP_RESET_BIT,1,1);
}

uint8_t getIntStatus(void) {
    uint8_t buffer;
    mpuConfiguration.read(MPU_RA_INT_STATUS,1, &buffer);
    return buffer;
}

void setMemoryBank(uint8_t bank) {
    bank &= 0x1F;
    mpuConfiguration.write(MPU_RA_BANK_SEL, bank);
}

void setMemoryStartAddress(uint8_t address) {
    mpuConfiguration.write(MPU_RA_MEM_START_ADDR, address);
}

void readMemoryBlock(uint8_t *data, uint16_t dataSize, uint8_t bank, uint8_t address) {
    setMemoryBank(bank);
    setMemoryStartAddress(address);
    uint8_t chunkSize;
    int16_t i;
    for (i = 0; i < dataSize;) {
        // determine correct chunk size according to bank position and data size
        chunkSize = MPU6050_DMP_MEMORY_CHUNK_SIZE;

        // make sure we don't go past the data size
        if (i + chunkSize > dataSize) chunkSize = dataSize - i;

        // make sure this chunk doesn't go past the bank boundary (256 bytes)
        if (chunkSize > 256 - address) chunkSize = 256 - address;

        // read the chunk of data as specified
        mpuConfiguration.read(MPU_RA_MEM_R_W, chunkSize, data + i);
        
        // increase byte index by [chunkSize]
        i += chunkSize;

        // uint8_t automatically wraps to 0 at 256
        address += chunkSize;

        // if we aren't done, update bank (if necessary) and address
        if (i < dataSize) {
            if (address == 0) bank++;
            setMemoryBank(bank);
            setMemoryStartAddress(address);
        }
    }
}

bool writeMemoryBlock(const uint8_t *data, uint16_t dataSize, uint8_t bank, uint8_t address, bool verify) {
    setMemoryBank(bank);
    setMemoryStartAddress(address);
    uint8_t chunkSize;
    uint8_t verifyBuffer[MPU6050_DMP_MEMORY_CHUNK_SIZE];
    uint8_t *progBuffer;
    uint16_t i;

    for (i = 0; i < dataSize;) {
        // determine correct chunk size according to bank position and data size
        chunkSize = MPU6050_DMP_MEMORY_CHUNK_SIZE;

        // make sure we don't go past the data size
        if (i + chunkSize > dataSize) chunkSize = dataSize - i;

        // make sure this chunk doesn't go past the bank boundary (256 bytes)
        if (chunkSize > 256 - address) chunkSize = 256 - address;

        // write the chunk of data as specified
        progBuffer = (uint8_t *) data + i;


        mpuConfiguration.writeBytes(MPU_RA_MEM_R_W, chunkSize, progBuffer);

        // verify data if needed
        if (verify) {
            setMemoryBank(bank);
            setMemoryStartAddress(address);
            mpuConfiguration.read(MPU_RA_MEM_R_W, chunkSize, verifyBuffer);
            if (memcmp(progBuffer, verifyBuffer, chunkSize) != 0) {
                return false; // uh oh.
            }
        }

        // increase byte index by [chunkSize]
        i += chunkSize;

        // uint8_t automatically wraps to 0 at 256
        address += chunkSize;

        // if we aren't done, update bank (if necessary) and address
        if (i < dataSize) {
            if (address == 0) bank++;
            setMemoryBank(bank);
            setMemoryStartAddress(address);
        }
    }
    return true;
}


bool writeDMPConfigurationSet(const uint8_t *data, uint16_t dataSize) {
    uint8_t *progBuffer = 0;
    uint8_t success, special;
    uint16_t i;


    // config set data is a long string of blocks with the following structure:
    // [bank] [offset] [length] [byte[0], byte[1], ..., byte[length]]
    uint8_t bank, offset, length;
    for (i = 0; i < dataSize;) {
        bank = data[i++];
        offset = data[i++];
        length = data[i++];

        // write data or perform special action
        if (length > 0) {
            // regular block of data to write
            progBuffer = (uint8_t *) data + i;

            success = writeMemoryBlock(progBuffer, length, bank, offset, true);
            i += length;
        } else {
            // special instruction
            // NOTE: this kind of behavior (what and when to do certain things)
            // is totally undocumented. This code is in here based on observed
            // behavior only, and exactly why (or even whether) it has to be here
            // is anybody's guess for now.
            special = data[i++];

            if (special == 0x01) {
                // enable DMP-related interrupts
                mpuConfiguration.write(MPU_RA_INT_ENABLE, 0x32); // single operation
                success = true;
            } else {
                // unknown special command
                success = false;
            }
        }

        if (!success) {
            return false; // uh oh
        }
    }
    return true;
}

static uint8_t dmpInitialize(void) {
    uint8_t xgOffsetTC, ygOffsetTC, zgOffsetTC;
  //  uint16_t fifoCount;// = getFIFOCount();
//    uint8_t fifoBuffer[256];
    
    setMemoryBank(0);
    xgOffsetTC = ReadBits(MPU_RA_XG_OFFS_TC, MPU6050_TC_OFFSET_BIT, MPU6050_TC_OFFSET_LENGTH);
    ygOffsetTC = ReadBits(MPU_RA_YG_OFFS_TC, MPU6050_TC_OFFSET_BIT, MPU6050_TC_OFFSET_LENGTH);
    zgOffsetTC = ReadBits(MPU_RA_ZG_OFFS_TC, MPU6050_TC_OFFSET_BIT, MPU6050_TC_OFFSET_LENGTH);
 
   

    // setup weird slave stuff (?)
    mpuConfiguration.write( MPU_RA_I2C_SLV0_ADDR, 0x7F);
    SetBits(MPU_RA_USER_CTRL, 1<<MPU6050_USERCTRL_I2C_MST_EN_BIT);
    mpuConfiguration.write( MPU_RA_I2C_SLV0_ADDR, 0x68);
    SetBits(MPU_RA_USER_CTRL, 1<<MPU6050_USERCTRL_I2C_MST_RESET_BIT);
    delay(20);
    
    
    if (!writeMemoryBlock(dmpMemory, MPU6050_DMP_CODE_SIZE, 0, 0, true)) return (1);

    if (!writeDMPConfigurationSet(dmpConfig, MPU6050_DMP_CONFIG_SIZE)) return (2);
  
    mpuConfiguration.write(MPU_RA_PWR_MGMT_1, 0x03); //PWR_MGMT_1    -- SLEEP 0; CYCLE 0; TEMP_DIS 0; CLKSEL 3 (PLL with Z Gyro reference)
    delay(15); //PLL Settling time when changing CLKSEL is max 10ms.  Use 15ms to be sure 

    //  DEBUG_PRINTLN(F("Setting DMP and FIFO_OFLOW interrupts enabled..."));
    mpuConfiguration.write(MPU_RA_INT_ENABLE, 0x12);

    //DEBUG_PRINTLN(F("Setting sample rate to 200Hz..."));
    mpuConfiguration.write(MPU_RA_SMPLRT_DIV, 4); // 1khz / (1 + 4) = 200 Hz

    // DEBUG_PRINTLN(F("Setting external frame sync to TEMP_OUT_L[0]..."));
    WriteBits(MPU_RA_CONFIG, MPU6050_CFG_EXT_SYNC_SET_BIT, MPU6050_CFG_EXT_SYNC_SET_LENGTH, MPU6050_EXT_SYNC_TEMP_OUT_L);
 
    // DEBUG_PRINTLN(F("Setting DLPF bandwidth to 42Hz..."));
    mpuConfiguration.write(MPU_RA_CONFIG, INV_FILTER_42HZ);

    //DEBUG_PRINTLN(F("Setting gyro sensitivity to +/- 2000 deg/sec..."));
    mpuConfiguration.write(MPU_RA_GYRO_CONFIG, INV_FSR_2000DPS << 3); //GYRO_CONFIG   -- FS_SEL = 3: Full scale set to 2000 deg/sec

    // DEBUG_PRINTLN(F("Setting DMP configuration bytes (function unknown)..."));
    mpuConfiguration.write(MPU_RA_DMP_CFG_1, 0x03);
    mpuConfiguration.write(MPU_RA_DMP_CFG_2, 0x00);

    // DEBUG_PRINTLN(F("Clearing OTP Bank flag..."));
    ClearBits(MPU_RA_XG_OFFS_TC, 1<<MPU6050_TC_OTP_BNK_VLD_BIT);

    // DEBUG_PRINTLN(F("Setting X/Y/Z gyro offset TCs to previous values..."));
    WriteBits(MPU_RA_XG_OFFS_TC, MPU6050_TC_OFFSET_BIT, MPU6050_TC_OFFSET_LENGTH,xgOffsetTC);
    WriteBits(MPU_RA_YG_OFFS_TC, MPU6050_TC_OFFSET_BIT, MPU6050_TC_OFFSET_LENGTH,ygOffsetTC);
    WriteBits(MPU_RA_ZG_OFFS_TC, MPU6050_TC_OFFSET_BIT, MPU6050_TC_OFFSET_LENGTH,zgOffsetTC);

    // DEBUG_PRINTLN(F("Writing final memory update 1/7 (function unknown)..."));
    uint8_t dmpUpdate[16], j;
    uint16_t pos = 0;
    for (j = 0; j < 4 || j < dmpUpdate[2] + 3; j++, pos++) dmpUpdate[j] = dmpUpdates[pos];
    writeMemoryBlock(dmpUpdate + 3, dmpUpdate[2], dmpUpdate[0], dmpUpdate[1],false);

    //DEBUG_PRINTLN(F("Writing final memory update 2/7 (function unknown)..."));
    for (j = 0; j < 4 || j < dmpUpdate[2] + 3; j++, pos++) dmpUpdate[j] = dmpUpdates[pos];
    writeMemoryBlock(dmpUpdate + 3, dmpUpdate[2], dmpUpdate[0], dmpUpdate[1],false);

    //DEBUG_PRINTLN(F("Resetting FIFO..."));
    SetBits(MPU_RA_USER_CTRL, 1<<MPU6050_USERCTRL_FIFO_RESET_BIT);

   // DEBUG_PRINTLN(F("Reading FIFO count..."));


   // DEBUG_PRINT(F("Current FIFO count="));
  //  DEBUG_PRINTLN(fifoCount);
   // getFIFOBytes(fifoBuffer, fifoCount);

//    DEBUG_PRINTLN(F("Setting motion detection threshold to 2..."));
    mpuConfiguration.write(MPU_RA_MOT_THR, 2);

  //  DEBUG_PRINTLN(F("Setting zero-motion detection threshold to 156..."));
    mpuConfiguration.write(MPU_RA_ZRMOT_THR,156);

    //DEBUG_PRINTLN(F("Setting motion detection duration to 80..."));
    mpuConfiguration.write(MPU_RA_MOT_DUR, 80);

    //DEBUG_PRINTLN(F("Setting zero-motion detection duration to 0..."));
    mpuConfiguration.write(MPU_RA_ZRMOT_DUR,0);
  
    
    //DEBUG_PRINTLN(F("Resetting FIFO..."));
    SetBits(MPU_RA_USER_CTRL, 1<<MPU6050_USERCTRL_FIFO_RESET_BIT);
    //DEBUG_PRINTLN(F("Enabling FIFO..."));
    SetBits(MPU_RA_USER_CTRL, 1<<MPU6050_USERCTRL_FIFO_EN_BIT);

   // DEBUG_PRINTLN(F("Enabling DMP..."));
    setDMPEnabled(true);

   // DEBUG_PRINTLN(F("Resetting DMP..."));
    resetDMP();

   // DEBUG_PRINTLN(F("Writing final memory update 3/7 (function unknown)..."));
    for (j = 0; j < 4 || j < dmpUpdate[2] + 3; j++, pos++) dmpUpdate[j] = dmpUpdates[pos];
    writeMemoryBlock(dmpUpdate + 3, dmpUpdate[2], dmpUpdate[0], dmpUpdate[1],false);

   // DEBUG_PRINTLN(F("Writing final memory update 4/7 (function unknown)..."));
    for (j = 0; j < 4 || j < dmpUpdate[2] + 3; j++, pos++) dmpUpdate[j] = dmpUpdates[pos];
    writeMemoryBlock(dmpUpdate + 3, dmpUpdate[2], dmpUpdate[0], dmpUpdate[1],false);

   // DEBUG_PRINTLN(F("Writing final memory update 5/7 (function unknown)..."));
    for (j = 0; j < 4 || j < dmpUpdate[2] + 3; j++, pos++) dmpUpdate[j] = dmpUpdates[pos];
    writeMemoryBlock(dmpUpdate + 3, dmpUpdate[2], dmpUpdate[0], dmpUpdate[1],false);

    
  delay(30); 
   // DEBUG_PRINTLN(F("Waiting for FIFO count > 2..."));

    //DEBUG_PRINT(F("Current FIFO count="));
    //DEBUG_PRINTLN(fifoCount);
    //DEBUG_PRINTLN(F("Reading FIFO data..."));
   // getFIFOBytes(fifoBuffer, fifoCount);

//    DEBUG_PRINTLN(F("Reading interrupt status..."));

  //  DEBUG_PRINT(F("Current interrupt status="));
  //  DEBUG_PRINTLNF(getIntStatus(), HEX);
   // getIntStatus(); // para limpar as flags!
        
    //DEBUG_PRINTLN(F("Reading final memory update 6/7 (function unknown)..."));
    for (j = 0; j < 4 || j < dmpUpdate[2] + 3; j++, pos++) dmpUpdate[j] = dmpUpdates[pos];
    readMemoryBlock(dmpUpdate + 3, dmpUpdate[2], dmpUpdate[0], dmpUpdate[1]);
      delay(30); 
  //delay(15); 
    //DEBUG_PRINTLN(F("Waiting for FIFO count > 2..."));
//    fifoCount=0;
//    while ((fifoCount<3))
//    {
//            fifoCount = getFIFOCount();
//    }

   // DEBUG_PRINT(F("Current FIFO count="));
   // DEBUG_PRINTLN(fifoCount);

   // DEBUG_PRINTLN(F("Reading FIFO data..."));
    //getFIFOBytes(fifoBuffer, fifoCount);

   // DEBUG_PRINTLN(F("Reading interrupt status..."));

   // DEBUG_PRINT(F("Current interrupt status="));
    //DEBUG_PRINTLNF(getIntStatus(), HEX);
    //getIntStatus();

   // DEBUG_PRINTLN(F("Writing final memory update 7/7 (function unknown)..."));
    for (j = 0; j < 4 || j < dmpUpdate[2] + 3; j++, pos++) dmpUpdate[j] = dmpUpdates[pos];
    writeMemoryBlock(dmpUpdate + 3, dmpUpdate[2], dmpUpdate[0], dmpUpdate[1],false);
        SetBits(MPU_RA_USER_CTRL, 1<<MPU6050_USERCTRL_FIFO_RESET_BIT);
  delay(30);
 
    SetBits(MPU_RA_USER_CTRL, 1<<MPU6050_USERCTRL_FIFO_RESET_BIT)
        
   // DEBUG_PRINTLN(F("DMP is good to go! Finally."));

   // DEBUG_PRINTLN(F("Disabling DMP (you turn it on later)..."));
   // setDMPEnabled(false);

   // DEBUG_PRINTLN(F("Setting up internal 42-byte (default) DMP packet buffer..."));
  //  dmpPacketSize = 42;
    /*if ((dmpPacketBuffer = (uint8_t *)malloc(42)) == 0) {
        return 3; // TODO: proper error code for no memory
    }*/

   // DEBUG_PRINTLN(F("Resetting FIFO and clearing INT status one last time..."));
    ;
   // getIntStatus();
#warning "todo!"
  //  WriteBits( MPU_RA_XG_OFFS_TC, MPU6050_TC_OFFSET_BIT, MPU6050_TC_OFFSET_LENGTH, 220);
  //  WriteBits( MPU_RA_YG_OFFS_TC, MPU6050_TC_OFFSET_BIT, MPU6050_TC_OFFSET_LENGTH, 76);
   // WriteBits( MPU_RA_XG_OFFS_TC, MPU6050_TC_OFFSET_BIT, MPU6050_TC_OFFSET_LENGTH, -85);
   // mpuConfiguration.write(MPU_RA_ZA_OFFS_H,1788); // 1688 factory default for my test chip
  
  
  
    
    return (0);
}